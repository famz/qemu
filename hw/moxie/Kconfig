## hw/moxie/Kconfig
```kconfig
config MOXIESIM
    bool
    select MC146818RTC
    select SERIAL
    select VGA
    default y
```

## hw/net/Kconfig
```kconfig
menu "Network devices"
    config DP8393X
        bool

    config XEN_BACKEND
        bool

    config NE2000_PCI
        bool "NE2000 ethernet card"
        depends on PCI

    config EEPRO100_PCI
        bool "Intel EEPRO100"
        depends on PCI

    config PCNET_COMMON
        bool

    config PCNET_PCI
        bool
        depends on PCI
        select PCNET_COMMON

    config E1000_PCI
        bool "Intel Gigabit E1000 ethernet"
        depends on PCI

    config RTL8139_PCI
        bool "Realtek RTL8139 ethernet"
        depends on PCI

    config VMXNET3_PCI
        bool "VmWare paravirtual Ethernet v3"
        depends on PCI

    config SMC91C111
        bool

    config LAN9118
        bool
        select PTIMER

    config NE2000_ISA
        bool
        select NE2000_PCI

    config OPENCORES_ETH
        bool

    config XGMAC
        bool

    config MIPSNET
        bool 

    config XILINX_AXI
        bool

    config STELLARIS_ENET
        bool

    config LANCE
        bool
        select PCNET_COMMON

    config COLDFIRE
        bool

    config XILINX_ETHLITE
        bool

    config VIRTIO
        default y
        bool
endmenu
```

## hw/openrisc/Kconfig
```kconfig
menu "OpenRISC"
    config OPENRISC_SIM    
        bool
        select SERIAL
        select OPENCORES_ETH
        default y
endmenu
```

## hw/pci-host/Kconfig
```kconfig
config PREP_PCI
    bool
    select PCI

config GRACKLE_PCI
    bool
    select PCI

config UNIN_PCI
    bool
    select PCI

config PPCE500_PCI
    bool
    select PCI

config VERSATILE_PCI
    bool
    select PCI

config PCI_APB
    bool
    select PCI

config FULONG
    bool
    select PCI

config PCI_PIIX
    bool
    select PCI
    #select ISA

config PCI_Q35
    bool
    select PCI
```

## hw/pci/Kconfig
```kconfig
config PCI
    bool

menu "PCI"
    config PCI_HOTPLUG
        bool "Enable hotplugging for PCI devices"
        depends on PCI
endmenu
```

## hw/ppc/Kconfig
```kconfig
menu "PowerPc (PPC)"
    config PSERIES
        bool "PowerPC pSeries Logical Partition"
        default n
        select VGA_PCI
        select NVRAM
        select PFLASH_CFI02
        select PCI_OHCI
        # error: ‘CPUPPCState’ has no member named ‘sps’

    config PPC4XX 
        bool

    config PPC405_UC
        bool
        select PPC4XX
        select SERIAL
        # for monitor.c
        select PCI
        select I8259

    config PPC405
        bool "PowerPC 405EP reference board"
        default y
        select PFLASH_CFI02
        select M48T59
        select PPC405_UC

    config PPC440
        bool "PowerPC 440 Bamboo"
        default y
        select PPC405_UC

    config VIRTEX
        bool "Xilinx Virtex5 ML507"
        default y
        select SERIAL
        select PFLASH_CFI01
        select XILINX
        select PPC405_UC

    config PREP
        bool "PowerPC Reference Platform (PReP)"
        default y
        select FDC
        select PC87312
        select I82378
        select MC146818RTC
        select PREP_PCI
        select IDE_ISA
        select M48T59
        select PCI_OHCI
        select IDE_CORE
        select PCKBD
        select PPC405_UC

    config MAC_OLDWORLD
        bool "OldWorld PowerMac"
        default y
        select ADB
        select ISA_MMIO
        select HEATHROW_PIC
        select GRACKLE_PCI
        select ESCC
        select IDE_CORE
        select IDE_MACIO
        select PCI_OHCI
        select VGA_PCI
        select CUDA
        select MAC_DBDMA
        select PPC405_UC

    config MAC_NEWWORLD
        bool "NewWorld PowerMac"
        default y
        select ADB
        select M48T59
        select OPENPIC
        select ESCC
        select ISA_MMIO
        select UNIN_PCI
        select VGA_PCI
        select IDE_MACIO
        select IDE_CORE
        select CUDA
        select USB_OHCI
        select MAC_DBDMA
        select OPENPIC
        select PPC405_UC

    config E500
        bool "PowerPC e500-based platforms"
        default y
        select OPENPIC
        select SERIAL
        select PPCE500_PCI
        select PPC405_UC
endmenu
```

## hw/s390x/Kconfig
```kconfig
menu "s390x"
    config S390_VIRTIO
        bool "s390x virtio"
        select SCLPCONSOLE
        default y

    config S390_CCW
        bool "s390x virtio ccw"
        select SCLPCONSOLE
        select S390_VIRTIO
        default y
endmenu
```

## hw/scsi/Kconfig
```kconfig
menu "SCSI devices"
    config LSI_SCSI_PCI
        bool "LSI53C895A SCSI Host Bus Adapter"
        depends on PCI

    config MEGASAS_SCSI_PCI
        bool "MegaRAID SAS 8708EM2 Host Bus Adapter"
        depends on PCI

    config VMW_PVSCSI_SCSI_PCI
        bool "VMware PVSCSI paravirtual SCSI bus"
        depends on PCI

    config ESP
        bool

    config ESP_PCI
        bool "ESP/NCR53C9x"
        depends on PCI
        select ESP
endmenu
```

## hw/sd/Kconfig
```kconfig
config SD
    bool

config PL181
    bool
    select SD

config SSI_SD
    bool
    select SD
    select SSI

config SDHCI
    bool
    select SD

config MILKYMIST
    bool
    select SD

config PXA2XX
    bool
    select SD

config OMAP
    bool
    select SD
```

## hw/sh4/Kconfig
```kconfig
menu "SH4"
    config SH4
        bool
        default y

    config R2D
        bool "Renesas SH7751R R2D-PLUS"
        select PFLASH_CFI02
        select PCI
        select SM501
        select SERIAL
        select IDE_MMIO

    config SHIX
        bool "SHIX 2.0 board"
        select PCI
endmenu
```

## hw/sparc/Kconfig
```kconfig
menu "Sparc"
    config SUN4M
        bool "Sun4m & Sun4d & Sun4c"
        select EMPTY_SLOT
        select ESCC
        select ESP
        select M48T59
        select SLAVIO
        select FDC
        default y

    config LEON3
        bool "Leon3"
        select GRLIB
        select SUN4M
        select STP2000
        default y
endmenu
```

## hw/sparc64/Kconfig
```kconfig
config SUN4M
    bool
    select ISA_MMIO
    select M48T59
    select PTIMER
    select VGA_PCI
    select SERIAL
    select PARALLEL
    select PCKBD
    select FDC
    select IDE_CMD646
    select PCI_APB
    select MC146818RTC
    select ISA_TESTDEV
```

## hw/ssi/Kconfig
```kconfig
config SSI
    bool

config PL022
    bool
    select SSI

config XILINX_SPI
    bool
    select SSI

config XILINX_SPIPS
    bool
    select SSI
```

## hw/timer/Kconfig
```kconfig
config ARM_TIMER
    bool
    select PTIMER

config CADENCE
    bool

config DS1338
    bool

config HPET
    bool

config I8254
    bool
    select MC146818RTC
    #depends on ISA

config M48T59
    bool
    #depends on ISA

config PL031
    bool

config PUV3
    bool
    select PTIMER

config TWL92230
    bool

config XILINX
    bool
    select PTIMER

config SLAVIO
    bool
    select PTIMER

config ETRAXFS
    bool
    select PTIMER

config GRLIB
    bool
    select PTIMER

config IMX
    bool
    select PTIMER

config LM32
    bool
    select PTIMER

config MILKYMIST
    bool
    select PTIMER

config EXYNOS4
    bool
    select PTIMER

config SH4
    bool
    select PTIMER

config TUSB6010
    bool
    select USB_MUSB

config ARM_MPTIMER
    bool
    select PTIMER

config MC146818RTC
    bool
    select PTIMER
    #depends on APIC
    #depends on ISA
```

## hw/usb/Kconfig
```kconfig
menu "USB devices"
    config USB_UHCI
        bool "USB UHCI support"
        default y
        
    config USB_OHCI
        bool "USB OHCI support"
        default y
        depends on PCI

    config USB_OHCI_SYSBUS
        bool
        select USB_OHCI

    config USB_OHCI_PCI
        bool
        select USB_OHCI

    config USB_EHCI
        bool "USB EHCI support"
        default y

    config USB_EHCI_SYSBUS
        bool
        select USB_EHCI

    config USB_EHCI_PCI
        bool
        select USB_EHCI

    config USB_XHCI
        bool "USB XHCI support"
        default y
        depends on PCI

    config USB_MUSB
        bool "USB MUSB support"
        default y

    config USB_TABLET_WACOM
        bool "Wacom tablet USB"
        default y

    config USB_STORAGE_BOT
        bool "USB harddrive support"
        default y

    config USB_STORAGE_UAS
        bool "UAS storage"
        default y

    config USB_AUDIO
        bool "USB audio"
        default y

    config USB_SERIAL
        bool "USB serial port adapter"
        default y

    config USB_NETWORK
        bool "USB networking"

    config USB_BLUETOOTH
        bool "USB bluetooth"
        default y

    config USB_SMARTCARD
        bool "USB Smart Card"
        default y

    config USB_SMARTCARD_NSS
        bool "Emulated USB Smart Card"

    config USB_REDIR
        bool "USB redirection device"
endmenu
```

## hw/watchdog/Kconfig
```kconfig
config WDT_IB6300ESB
    bool
    depends on PCI

config WDT_IB700
    bool
    #depends on ISA
```

## hw/xtensa/Kconfig
```kconfig
config XTENSA_SIM
    bool "Xtensa simulator"
    default y

config XTENSA_LX60
    bool "Xtensa lx60"
    select SERIAL
    select PFLASH_CFI01
    select OPENCORES_ETH
    default y
```
