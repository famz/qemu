## hw/misc/Kconfig
```kconfig
config APPLESMC
    bool
    #depends on ISA
    
config MAX111X
    bool
    depends on SSI

config TMP105
    bool
    #depends on I2C

config ISA_DEBUG
    bool
    #depends on ISA

config SGA
    bool
    #depends on PCI

config ISA_TESTDEV
    bool
    #depends on ISA

config PCI_TESTDEV
    bool
    depends on PCI

config VMPORT
    bool
    #depends on ISA

config PL310
    bool

config PUV3
    bool

config MACIO
    bool
    depends on PCI
    select MAC_NVRAM

config CUDA
    bool
    select MACIO

config MAC_DBDMA
    bool   
    select MACIO
    select ADB
    #depends on ISA

config A9SCU
    bool

config ECCMEMCTL
    bool
    select ECC

config OMAP
    bool
    select ECCMEMCTL
    select NAND
    
config PVPANIC
    bool
```
