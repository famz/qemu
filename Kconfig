## Kconfig
```kconfig
# Kconfig SeaBIOS configuration

mainmenu "QEMU Configuration"

# Include the user-selected Kconfigs
menu "Boards"
    source "Kconfig.targets"
endmenu

# Device and bus configurations
source "hw/Kconfig"
```

## hw/Kconfig
```kconfig
source "hw/9pfs/Kconfig"
source "hw/audio/Kconfig"
source "hw/acpi/Kconfig"
source "hw/block/Kconfig"
source "hw/char/Kconfig"
source "hw/core/Kconfig"
source "hw/cpu/Kconfig"
source "hw/display/Kconfig"
source "hw/dma/Kconfig"
source "hw/gpio/Kconfig"
source "hw/i2c/Kconfig"
source "hw/input/Kconfig"
source "hw/intc/Kconfig"
source "hw/ide/Kconfig"
source "hw/isa/Kconfig"
source "hw/misc/Kconfig"
source "hw/net/Kconfig"
source "hw/nvram/Kconfig"
source "hw/pci-bridge/Kconfig"
source "hw/pci-host/Kconfig"
source "hw/pci/Kconfig"
source "hw/scsi/Kconfig"
source "hw/sd/Kconfig"
source "hw/ssi/Kconfig"
source "hw/timer/Kconfig"
source "hw/tpm/Kconfig"
source "hw/usb/Kconfig"
source "hw/watchdog/Kconfig"
```

## hw/alpha/Kconfig
```kconfig
config CLIPPER
    bool
    select PCI
    select VGA_PCI
    select SERIAL
    select IDE_ISA
    select I8259
    select IDE_PIIX
    select I8254
    select PCKBD
    select MC146818RTC
    select IDE_CMD646
    default y
```

## hw/arm/Kconfig
```kconfig
menu "ARM" 
    config ARMV7M
        bool
        default y

    config EXYNOS4
        bool "Samsung Exynos4210 SoC"
        select A9MPCORE
        select A9SCU # snoop controll unit
        select ARMV7M
        select ARMV7M_NVIC
        select ARM_GIC
        select ARM_MPTIMER
        select LAN9118
        select PL310 # cache controller
        select USB_EHCI
        select USB_EHCI_SYSBUS
        default y

    config HIGHBANK
        bool "Calxeda Highbank SoC"
        select A15MPCORE
        select A9MPCORE
        select A9SCU # snoop controll unit
        select AHCI
        select ARMV7M_NVIC
        select ARM_MPTIMER
        select ARM_TIMER # sp804
        select PCI
        select PL011 # UART
        select PL022 # Serial port
        select PL031 # RTC
        select PL061 # GPIO
        select PL310 # cache controller
        select XGMAC # ethernet
        default y

    config INTEGRATORCP
        bool "ARM Integrator CP"
        select SMC91C111
        select ARM_TIMER
        select ARMV7M_NVIC
        select PL011 # UART
        select PL031 # RTC
        select PL050 # keyboard/mouse
        select PL110 # pl111 LCD controller
        select PL181 # display
        default y

    config KZM
        bool "Kzm"
        select SERIAL
        select IMX
        select LAN9118
        select ARMV7M_NVIC
        default y

    config MUSICPAL
        bool "Marvell MV88W8618 / Freecom MusicPal"
        select PFLASH_CFI02
        select PTIMER
        select BITBANG_I2C
        select MARVELL_88W8618
        select ARMV7M_NVIC
        select WM8750
        select SERIAL
        default y

    config OMAP
        bool
        select SERIAL
        select PFLASH_CFI01
        select PCI
        select ARMV7M_NVIC

    config NSERIES
        bool "Nokia N-Series tablets"
        select TMP105   # tempature sensor
        select BLIZZARD # LCD/TV controller
        select ONENAND 
        select TSC210X  # touchscreen/sensors/audio
        select TSC2005  # touchscreen/sensors/keypad
        select LM832X   # GPIO keyboard chip
        select TWL92230 # energy-management
        select OMAP
        default y

    config PALM
        bool "PalmOne PDAs"
        select TSC210X
        select OMAP
        default y

    config STELLARIS
        bool "Stellaris"
        select PL011 # UART
        select PL022 # Serial port
        select PL061 # GPIO
        select STELLARIS_INPUT
        select STELLARIS_ENET # ethernet
        select SSD0303 # OLED display
        select SSD0323 # OLED display
        select SSI_SD
        select ARMV7M_NVIC
        default y

    config REALVIEW
        bool "ARM Realview baseboard"
        select LAN9118
        select SMC91C111

        select VERSATILE_PCI
        select WM8750 # audio codec
        select PL011  # UART
        select PL041  # audio codec
        select PL050  # keyboard/mouse
        select PL061  # GPIO
        select PL080  # DMA controller
        select PL110  # display
        select VERSATILE_I2C
        select DS1338 # I2C RTC+NVRAM
        select USB_OHCI
        select ARM_GIC
        select ARMV7M_NVIC
        select ARM_TIMER
        select ARM15MPCORE
        select ARM11MPCORE
        select ARM9MPCORE
    
    config VERSATILEPB
        bool "ARM Versatile platform"
        select PFLASH_CFI01
        select PL031  # RTC
        select PL050  # keyboard/mouse
        select PL080  # DMA controller
        select PL181  # display
        select PL190  # Vector PIC
        select ARM_TIMER # sp804
        select USB_OHCI
        select LSI_SCSI_PCI
        select REALVIEW
        default y

    config VXPRESS
        bool "ARM Versatile Express"
        select PFLASH_CFI01
        select LAN9118
        select PL011 # UART
        select PL031  # RTC
        select PL041 # audio codec
        select PL110 # pl111 LCD controller
        select PL181  # display
        select PL310 # cache controller
        select A9SCU # snoop controll unit
        select ARM_TIMER # sp804
        select ARM_MPTIMER
        select ARM15MPCORE
        select ARM9MPCORE
        select REALVIEW
        default y

    config ZYNQ
        bool "Xilinx Zynq Baseboard"
        select ARM9MPCORE
        select CADENCE # UART
        select PCI
        select PFLASH_CFI02
        select SDHCI
        select USB_EHCI
        select XILINX # UART
        select XILINX_SPI
        select XILINX_SPISS
        default y

    config PXA2XX
        bool "Intel XScale PXA255/270"
        select SERIAL
        select PCI
        select USB_OHCI
        select SSI
        default y

    config GUMSTIX
        bool "Gumstix platform"
        select PFLASH_CFI01
        select SMC91C111
        depends on PXA2XX
        default y

    config TOSA
        bool "PXA255 Sharp Zaurus SL-6000 PDA platform"
        select ZAURUS  # scoop
        select MICRODRIVE
        depends on PXA2XX
        default y

    config MAINSTONE
        bool "PXA270-based Intel Mainstone"
        depends on PXA2XX
        select PFLASH_CFI01
        select SMC91C111
        default y

    config SPITZ
        bool "PXA270-based Clamshell PDA platforms"
        select ADS7846 # display
        select MAX111X # A/D converter
        select WM8750  # audio codec
        select MAX7310 # GPIO expander
        select ZAURUS  # scoop
        select NAND    # memory
        select ECC     # Error-correcting for NAND
        select MICRODRIVE
        depends on PXA2XX
        default y

    config Z2
        bool "Zipit Z2"
        select PFLASH_CFI01
        select WM8750
        select PL011 # UART
        depends on PXA2XX
        default y

    config STRONGARM
       bool 
       select PXA2XX

    config COLLIE
        bool "Sharp Zaurus SL-5500"
        select PFLASH_CFI01
        select ZAURUS  # scoop
        select STRONGARM
        default y
        help
            SA-1110-based Sharp Zaurus SL-5500 platform.
endmenu
```

## hw/audio/Kconfig
```kconfig
menu "Audio devices"
    config SB16
        bool
        #select ISA
    
    config ES1370
        bool "ES1370"
        depends on PCI

    config AC97
        bool "AC97 sound card"
        default y
        depends on PCI

    config ADLIB
        bool
        #select ISA

    config CS4231A
        bool

    config HDA
        bool
        #select ISA

    config PCSPK
        bool
        select I8254

    config WM8750
        bool

    config PL041
        bool

    config CS4231
        bool

    config MARVELL_88W8618
        bool
endmenu
```

## hw/block/Kconfig
```kconfig
config FDC
    bool
    select I8257 if !SUN4M
    #depends on ISA

config SSI_M25P80
    bool
    depends on SSI

config NAND
    bool

config PFLASH_CFI01
    bool

config PFLASH_CFI02
    bool

config ECC
    bool

config ONENAND
    bool

config PC_SYSFW
    bool
    #depends on ISA

config NVME_PCI
    bool
    depends on PCI
```

## hw/char/Kconfig
```kconfig
config IPACK 
    bool
    depends on PCI

config ESCC
    bool

config PARALLEL
    bool
    #depends on ISA

config SERIAL
    bool
    #depends on ISA

config SERIAL_PCI
    bool
    depends on PCI

config SCLPCONSOLE
    bool

config PL011
    bool
```

## hw/core/Kconfig
```kconfig
config EMPTY_SLOT
    bool

config XILINX_AXI
    bool

config PTIMER
    bool

config SOFTMMU
    bool
```

## hw/cpu/Kconfig
```kconfig
config ARM11MPCORE
    bool
    select ARM_GIC
    select ARM_MPTIMER
    select REALVIEW

config A9MPCORE
    bool 
    select ARM_GIC
    select ARM_MPTIMER
    select A9SCU

config A15MPCORE
    bool
    select ARM_GIC

config ICC_BUS
    bool
```

## hw/cris/Kconfig
```kconfig
config CRIS
    bool
    select ETRAXFS
    select NAND
    select PTIMER
    select PFLASH_CFI02
    default y
```

## hw/display/Kconfig
```kconfig
config ADS7846
    bool
    select SSI

config VGA_CIRRUS
    bool
    depends on PCI
    select VGA
    #select ISA

config G364FB
    bool

config JAZZ_LED
    bool

config PL110
    bool
    select FRAMEBUFFER

config SSD0303
    bool
    #select I2C

config SSD0323
    bool
    select SSI

config VGA_PCI
    bool
    select VGA
    depends on PCI

config VGA_ISA
    bool
    select VGA
    #select ISA

config VGA_ISA_MM
    bool
    select VGA

config VMWARE_VGA
    bool
    select VGA
    depends on PCI

config BLIZZARD
    bool

config FRAMEBUFFER
    bool

config MILKYMIST
    bool
    select FRAMEBUFFER

config ZAURUS
    bool
    select NAND
    select ECC

config OMAP
    bool
    select FRAMEBUFFER

config PXA2XX
    bool
    select FRAMEBUFFER

config MILKYMIST_TMU2
    bool

config SM501
    bool

config TCX
    bool

config VGA
    bool

config QXL
    bool
```

## hw/dma/Kconfig
```kconfig
config RC4030
    bool

config PL080
    bool

config PL330
    bool

config I82374
    bool
    select I8257
    #depends on ISA

config I8257
    bool
    #depends on ISA

config XILINX_AXI
    bool
    select PTIMER

config STP2000
    bool
    select SUN4M
```

## hw/i2c/Kconfig
```kconfig
config VERSATILE_I2C
    bool
    select BITBANG_I2C
    
config BITBANG_I2C
    bool
```

## hw/i386/Kconfig
```kconfig
menu "i386"
    config KVM
        bool
        select I8254
        select PIIX
        select LINUX

    config PIIX
       bool "Pentium IIx board" 
       select ACPI
       select APM
       select FDC
       select IDE_ISA
       select IDE_PIIX
       select MC146818RTC
       select PCI_PIIX
       select PCKBD
       select PFLASH_CFI01
       select SERIAL
       select USB_UHCI
       # interrupt controllers
       select I8259
       select APIC
       select IOAPIC
       #
       #select ISA
       select PVPANIC
       select ICC_BUS
       select PCSPK
       select VMPORT

    config Q35
        bool "Q36 chipset based PC"
        select ACPI
        select AHCI
        select APIC
        select FDC
        select I8254
        select I8259
        select ICC_BUS
        select IDE_MMIO
        select LPC_ICH9
        select PCI_Q35
        select PCKBD
        select PCSPK
        select PFLASH_CFI01
        select PVPANIC
        select SERIAL
        select USB_EHCI_PCI
        select VMPORT

    config XEN
        bool
endmenu
```

## hw/ide/Kconfig
```kconfig
config IDE_CORE
    bool
    #depends on ISA

config IDE_QDEV
    bool
    select IDE_CORE

config IDE_PCI
    bool
    select IDE_QDEV
    select USB_XHCI

config IDE_ISA
    bool
    #depends on ISA
    select IDE_QDEV

config IDE_PIIX
    bool
    select IDE_PCI
    depends on PCI

config IDE_CMD646
    bool
    #depends on ISA
    depends on PCI
    select IDE_QDEV

config IDE_MACIO
    bool
    select IDE_QDEV

config IDE_MMIO
    bool
    select IDE_QDEV

config IDE_VIA
    bool
    select IDE_QDEV
    select IDE_PIIX

config MICRODRIVE
    bool
    select IDE_CORE

config AHCI
    bool
    select IDE_QDEV
    depends on PCI
```

## hw/isa/Kconfig
```kconfig
#config ISA
#   bool

config APM
    bool

config I82378
    bool    
    #depends on ISA
    select I8259  # irq
    select PCSPK
    select I82374 # DMA
    select MC146818RTC # timer
    depends on PCI

config PC87312
    bool
    #depends on ISA 
    select SERIAL
    select PARALLEL
    select FDC
    select IDE_ISA

config PIIX4
    bool
    #depends on ISA 
    depends on PCI

config VT82C686
    bool
    #depends on ISA 
    depends on PCI
    depends on ACPI

config LPC_ICH9
    bool
    #depends on ISA 
    depends on PCI 
    select APM
```

## hw/lm32/Kconfig
```kconfig
menu "Verilog LatticeMicro32"
    config MILKYMIST
        bool "Milkymist System-on-Chip"
        select FRAMEBUFFER
        select PTIMER
        select PFLASH_CFI01
        select SD
        select MILKYMIST_TMU2
        select LM32
        default y

    config LM32
        bool
        select FRAMEBUFFER
        select PFLASH_CFI02
        default y
endmenu
```

## hw/m68k/Kconfig
```kconfig
menu "Motorola 68xxx"
    config AN5206
        bool "Arnewsh 5206 ColdFire"
        select MCF5206
        default y

    config DUMMY_M68K
        bool "Dummy m68k board"
        default y

    config MCF5206
        bool
        select PTIMER
        select COLDFIRE

    config MCF5208
        bool "Motorola ColdFire MCF5208 SoC emulation"
        select PTIMER
        select COLDFIRE
        default y
endmenu
```

## hw/microblaze/Kconfig
```kconfig
menu "Xilinx MicroBlaze"
    config PETALOGIX_S3ADSP1800
        bool "Petalogix board for Spartan S3ADSP-1800"
        select PCI
        select PFLASH_CFI01
        select XILINX
        select XILINX_ETHLITE

    config PETALOGIX_ML605
        bool "Petalogix board for Spartan ML605"
        select PFLASH_CFI01
        select SERIAL
        select SSI
        select XILINX
        select XILINX_ETHLITE
        select XILINX_AXI
        select XILINX_SPI
        select SSI_M25P80
endmenu
```

## hw/mips/Kconfig
```kconfig
menu "MIPS"
    config GT64XXX_PCI
        bool
        select PCI

    config R4K
        bool "MIPS pseudo-board"
        default y
        select I8254 # RTC
        select I8259 # int. controller
        select IDE_ISA
        select PCKBD
        select PFLASH_CFI01
        select PCI   # for PIIX4
        select PIIX4
        select SERIAL
        help
            Emulates a simple machine with ISA-like bus.

    config JAZZ
        bool "MIPS Jazz board"
        default y
        select DP8393X
        select ESP
        select FDC
        select I8254 # RTC
        select I8259 # int. controller
        select PARALLEL
        select PCKBD
        select PCI   # for PIIX4
        select PIIX4
        select RC4030
        select SERIAL
        select VGA_ISA_MM

    config MALTA
        bool "MIPS Malta board"
        default y
        select GT64XXX_PCI
        select ACPI
        select EMPTY_SLOT
        select FDC
        select I8259 # int. controller
        select MC146818RTC
        select PFLASH_CFI01
        select PIIX4
        select IDE_PIIX
        select SERIAL

    config FULONG
        bool "Fulong 2e mini pc"
        default y
        select IDE_VIA
        select SERIAL
        select I8259 # int. controller
        select I8254 # RTC
        select I8257 # DMA
        select PCI   # for VT82C686
        select ACPI  # for VT82C686
        select VT82C686
        help
            Fulong 2e mini pc is based on ICT/ST Loongson 2e CPU (MIPS III like, 800MHz)

    config MIPSSIM
        bool "MIPSsim-like machine emulation"
        default y
        select I8259 # int. controller
        select PCI   # for PIIX4
        select PIIX4
        select SERIAL
        help
            Emulates a very simple machine model similar to the one used by the proprietary MIPS emulator.
endmenu
```
